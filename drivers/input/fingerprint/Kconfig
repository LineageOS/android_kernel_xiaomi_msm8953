## drivers/input/fingerprint/Kconfig
```kconfig
config INPUT_FINGERPRINT
	tristate "Fingerprint driver support"
	help
	  Say Y here to enable goodix fingerprint driver support!
source "drivers/input/fingerprint/goodix_mido/Kconfig"
source "drivers/input/fingerprint/fpc_mido/Kconfig"
source "drivers/input/fingerprint/goodix_tissot/Kconfig"
source "drivers/input/fingerprint/fpc_tissot/Kconfig"
```

## drivers/input/fingerprint/fpc_mido/Kconfig
```kconfig
config FINGERPRINT_FPC1020_MIDO
	tristate "FingerPrint Cards fingerprint driver support"
	depends on INPUT_FINGERPRINT
	help
	  Say Y here to enable fpc fingerprint driver support!
```

## drivers/input/fingerprint/fpc_tiffany/Kconfig
```kconfig
config FINGERPRINT_FPC1020_TIFFANY
	tristate "FingerPrint Cards fingerprint driver support"
	depends on INPUT_FINGERPRINT
	help
	  Say Y here to enable fpc fingerprint driver support!
```

## drivers/input/fingerprint/fpc_tissot/Kconfig
```kconfig
config FINGERPRINT_FPC1020_TISSOT
	tristate "FingerPrint Cards fingerprint driver support"
	depends on INPUT_FINGERPRINT
	help
	  Say Y here to enable fpc fingerprint driver support!
```

## drivers/input/fingerprint/goodix_tiffany/Kconfig
```kconfig
config FINGERPRINT_GOODIX_GF3208_TIFFANY
	tristate "Goodix GF3208 fingerprint driver support"
	depends on INPUT_FINGERPRINT
	help
	  Say Y here to enable goodix fingerprint driver support!
```

## drivers/input/fingerprint/goodix_tissot/Kconfig
```kconfig
config FINGERPRINT_GOODIX_GF3208_TISSOT
	tristate "Goodix GF3208 fingerprint driver support"
	depends on INPUT_FINGERPRINT
	help
	  Say Y here to enable goodix fingerprint driver support!
```

## drivers/platform/xiaomi/Kconfig
```kconfig
# Xiaomi configuration options

config MACH_XIAOMI_MSM8953
	bool "Xiaomi MSM8953"
	depends on ARCH_MSM8953
	help
	  Support for MSM8953 Xiaomi variants

menu "Xiaomi board selection"

config MACH_XIAOMI_MIDO
        bool "Mido board"
        select MACH_XIAOMI_MSM8953
        help
          Support for Xiaomi Redmi note 4

config MACH_XIAOMI_TIFFANY
	bool "Tiffany board"
	select MACH_XIAOMI_MSM8953
	help
	  Support for Xiomi Mi 5X tiffany

config MACH_XIAOMI_TISSOT
	bool "Tissot board"
	select MACH_XIAOMI_MSM8953
	help
	  Support for Xiomi MI A1 tissot

endmenu
```
