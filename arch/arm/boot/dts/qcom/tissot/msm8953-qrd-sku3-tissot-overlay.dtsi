#include "msm-audio-tissot.dtsi"
#include "msm-pm8953-tissot.dtsi"
#include "msm-pmi8950-tissot.dtsi"
#include "msm8953-pinctrl-tissot.dtsi"
#include "msm8953-audio-tissot.dtsi"
#include "msm8953-camera-sensor-qrd-tissot.dtsi"
#include "dsi-panel-otm1911-fhd-video.dtsi"
#include "dsi-panel-ft8716-fhd-video.dtsi"
#include "dsi-panel-ili7807-fhd-video.dtsi"
#include "msm8953-pm-tissot.dtsi"
#include "msm8953-qrd-sku3-tissot.dtsi"
#include "msm8953-tissot.dtsi"
#include "msm8953-qrd-tissot.dtsi"
#include "msm8953-regulator-tissot.dtsi"
