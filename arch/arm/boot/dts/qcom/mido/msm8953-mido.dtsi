/*
 * Copyright (c) 2017, The Linux Foundation. All rights reserved.
 *
 * This program is free software; you can redistribute it and/or modify
 * it under the terms of the GNU General Public License version 2 and
 * only version 2 as published by the Free Software Foundation.
 *
 * This program is distributed in the hope that it will be useful,
 * but WITHOUT ANY WARRANTY; without even the implied warranty of
 * MERCHANTABILITY or FITNESS FOR A PARTICULAR PURPOSE.  See the
 * GNU General Public License for more details.
 */

#include "msm-audio-mido.dtsi"
#include "msm8953-general-mido.dtsi"
#include "msm8953-display-mido.dtsi"
#include "msm8953-camera-sensor-qrd-mido.dtsi"
#include "msm8953-pinctrl-mido.dtsi"
#include "msm8953-memory-mido.dtsi"
