#include "msm-audio-common.dtsi"
#include "msm-pm8953-common.dtsi"
#include "msm-pmi8950-common.dtsi"
#include "msm8953-pinctrl-common.dtsi"
#include "msm8953-audio-common.dtsi"
#include "msm8953-camera-sensor-qrd-common.dtsi"
#include "dsi-panel-otm1911-fhd-video.dtsi"
#include "dsi-panel-ft8716-fhd-video.dtsi"
#include "dsi-panel-ili7807-fhd-video.dtsi"
#include "msm8953-pm-common.dtsi"
#include "msm8953-qrd-sku3-common.dtsi"
#include "msm8953-common.dtsi"
#include "msm8953-qrd-common.dtsi"
#include "msm8953-regulator-common.dtsi"
