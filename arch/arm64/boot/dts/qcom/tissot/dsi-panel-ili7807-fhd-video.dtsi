/* Copyright (c) 2012-2015, The Linux Foundation. All rights reserved.
 *
 * This program is free software; you can redistribute it and/or modify
 * it under the terms of the GNU General Public License version 2 and
 * only version 2 as published by the Free Software Foundation.
 *
 * This program is distributed in the hope that it will be useful,
 * but WITHOUT ANY WARRANTY; without even the implied warranty of
 * MERCHANTABILITY or FITNESS FOR A PARTICULAR PURPOSE.  See the
 * GNU General Public License for more details.
 */

&mdss_mdp {
	dsi_ili7807_fhd_vid: qcom,mdss_dsi_ili7807_fhd_video {
		qcom,mdss-dsi-panel-name = "ili7807 fhd video mode dsi panel";
		qcom,mdss-dsi-panel-type = "dsi_video_mode";
		qcom,mdss-dsi-panel-framerate = <60>;
		qcom,mdss-dsi-virtual-channel-id = <0>;
		qcom,mdss-dsi-stream = <0>;
		qcom,mdss-dsi-panel-width = <1080>;
		qcom,mdss-dsi-panel-height = <1920>;
		qcom,mdss-dsi-h-front-porch = <84>;
		qcom,mdss-dsi-h-back-porch = <80>;
		qcom,mdss-dsi-h-pulse-width = <24>;
		qcom,mdss-dsi-h-sync-skew = <0>;
		qcom,mdss-dsi-v-back-porch = <16>;
		qcom,mdss-dsi-v-front-porch = <22>;
		qcom,mdss-dsi-v-pulse-width = <8>;
		qcom,mdss-dsi-h-left-border = <0>;
		qcom,mdss-dsi-h-right-border = <0>;
		qcom,mdss-dsi-v-top-border = <0>;
		qcom,mdss-dsi-v-bottom-border = <0>;
		qcom,mdss-dsi-bpp = <24>;
		qcom,mdss-dsi-underflow-color = <0xff>;
		qcom,mdss-dsi-border-color = <0>;
		qcom,mdss-dsi-on-command = [39 01 00 00 00 00 04 ff 78 07 05
				39 01 00 00 00 00 02 03 60
				39 01 00 00 00 00 02 04 03
				39 01 00 00 00 00 02 00 34
				39 01 00 00 00 00 04 ff 78 07 00
				39 01 00 00 00 00 02 35 00
				39 01 00 00 00 00 03 51 0f ff
				39 01 00 00 00 00 02 53 2c
				39 01 00 00 00 00 02 55 00
				39 01 00 00 78 00 02 11 00
				39 01 00 00 00 00 04 ff 78 07 06
				39 01 00 00 00 00 02 B2 22
				39 01 00 00 00 00 02 A2 07
				39 01 00 00 00 00 02 A3 1E
				39 01 00 00 00 00 04 ff 78 07 01
				39 01 00 00 00 00 02 65 04
				39 01 00 00 00 00 02 66 04
				39 01 00 00 00 00 02 6d 04
				39 01 00 00 00 00 04 ff 78 07 00
				39 01 00 00 14 00 02 29 00];
		qcom,mdss-dsi-off-command = [39 01 00 00 00 00 04 ff 78 07 00
				39 01 00 00 14 00 02 28 00
				39 01 00 00 78 00 02 10 00
				39 01 00 00 00 00 04 ff 78 07 01
				39 01 00 00 00 00 02 58 01];
		qcom,mdss-dsi-panel-timings-phy-v2 = [24 1F 08 09 05 03 04 a0
				24 1F 08 09 05 03 04 a0
				24 1F 08 09 05 03 04 a0
				24 1F 08 09 05 03 04 a0
				24 1B 08 09 05 03 04 a0];

		qcom,panel-supply-entries = <&dsi_panel_pwr_supply>;
		qcom,mdss-dsi-on-command-state = "dsi_lp_mode";
		qcom,mdss-dsi-off-command-state = "dsi_lp_mode";
		qcom,mdss-dsi-h-sync-pulse = <1>;
		qcom,mdss-dsi-traffic-mode = "burst_mode";
		qcom,mdss-dsi-bllp-eof-power-mode;
		qcom,mdss-dsi-bllp-power-mode;
		qcom,mdss-dsi-lane-0-state;
		qcom,mdss-dsi-lane-1-state;
		qcom,mdss-dsi-lane-2-state;
		qcom,mdss-dsi-lane-3-state;
		qcom,mdss-dsi-panel-timings = [7d 25 1d 00 37 33
			22 27 1e 03 04 00];
		qcom,mdss-dsi-t-clk-post = <0x0d>;
		qcom,mdss-dsi-t-clk-pre = <0x30>;
		qcom,mdss-dsi-bl-min-level = <1>;
		qcom,mdss-dsi-bl-max-level = <4095>;
		qcom,mdss-dsi-dma-trigger = "trigger_sw";
		qcom,mdss-dsi-mdp-trigger = "none";
		qcom,mdss-dsi-bl-pmic-control-type = "bl_ctrl_wled";
		qcom,mdss-dsi-reset-sequence = <1 10>, <0 10>, <1 10>;
		qcom,mdss-dsi-panel-status-command = [06 01 00 01 05 00 01 0A];
		qcom,mdss-dsi-panel-status-command-mode = "dsi_lp_mode";
		qcom,mdss-dsi-panel-status-check-mode = "TE_check_NT35596";
		qcom,mdss-dsi-panel-status-read-length = <1>;
		qcom,mdss-dsi-panel-status-value = <0x9C>;
		qcom,mdss-dsi-panel-max-error-count = <3>;
		qcom,mdss-pan-physical-width-dimension = <69>;
		qcom,mdss-pan-physical-height-dimension = <122>;
	};
};  
